//#include <SoftwareSerial.h>
//#include "src/libs/TinyWireM/TinyWireM.h"
#include "src/libs/ssd1337/ssd1327.h"

//SoftwareSerial serial(4, 3);

#define SSD1327_COMMAND_BYTE 0x00
#define SSD1327_DATA_BYTE 0x40
#define MAX_PACKAGE_LENGTH 16
#define address 0x3C

ssd1327 _display;

void pr(char* data) {
  //serial.println(data);
}

void setup() {
  //serial.begin(9600);

  _display.sendCommand(0xFD, 0x01, 0x12);                               // Unlock OLED
  _display.sendCommand(0xAE, 0x00);                                     // OFF
  //sendCommand(0xA8, 0x7F);                                            // multiplex 128
  //sendCommand(0xA1, 0x01, 0x00);                                      // Start line
  //sendCommand(0xA2, 0x01, 0x00);                                      // Display offset
  _display.remap(0x51);
  //_display.sendCommand(0xA0, 0x01, 0x40 | 0x10 | 0x00 | (0x02 | 0x01));
  _display.sendCommand(0xAB, 0x01, 0x01);                               // VDD internal
  //_display.sendCommand(0x81, 0x01, 0x70);                             // CONTRAST
  /*_display.sendCommand(0xB1, 0x01, 0x55);                             // PHASE 0x51
  _display.sendCommand(0xB3, 0x01, 0x01);                               // CLK*/
  _display.sendCommand(0xBC, 0x01, 0x08);                               // PRECHARGE
  _display.sendCommand(0xBE, 0x01, 0x07);                               // VCOMH voltage
  _display.sendCommand(0xB6, 0x01, 0x01);                               // Second pre-charge
  _display.sendCommand(0xA4, 0x00);                                     // NORMAL
  _display.sendCommand(0x2E, 0x00);                                     // Deactivate scroll

  _display.on();
  delay(500);
}

const PROGMEM uint8_t heartLength[] = { 61 };
const PROGMEM uint8_t heartPixels[] = { 0, 2, 4, 2, 6, 8, 10, 8, 12, 14, 16, 14, 0,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 78, 50 };
const PROGMEM uint8_t heartSequenceDictionary[] = { 5, 0, 8, 15, 10, 0, 9, 0, 11, 15, 6, 0, 7,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 2, 15 };

const uint8_t heartWidth = 36;
const uint8_t heartHeight = 32;

const PROGMEM uint8_t framesLength[]{55, 51, 59, 59, 63, 63, 55, 59, 55, 53, 55, 57, 57, 55, 57, 59, 65, 63, 63, 61, 59, 61, 59, 55, 47, 49, 59};
const PROGMEM uint8_t frames[]{0, 2, 4, 6, 8, 10, 12, 14, 16, 10, 18, 14, 16,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 100, 72};
const PROGMEM uint8_t sequenceDictionary[] = {219, 0, 5, 13, 28, 0, 6, 13, 33, 0, 2, 13, 61,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 220, 0};

const uint8_t animationFrames = 27;
const uint8_t animationWidth = 34;
const uint8_t animationHeight = 33;

void loop() {
  _display.clear(0);
  //_display.clearBorder(15, 0, 2, heartWidth, heartHeight);

  for (uint8_t i = 0; i < 40; i++) {
    if (i > 0) {
      delay(10);
      _display.clearBorder(0, i - 1, i + 1, heartWidth, heartHeight);
    }
    
    //_display.drawBitmap(heart, i, i + 2, heartWidth, heartHeight);
    _display.drawCompressedBitmap(heartPixels, heartSequenceDictionary, 0, pgm_read_byte_near(heartLength), i, i + 2, heartWidth, heartHeight);
  }
  
  _display.clear(0, 39, 41, heartWidth, heartHeight);

  for (uint8_t j = 0; j < animationFrames; j++) {//18 19 20  21  23 25
    uint16_t offset = 0;
    
    for (uint8_t i = 0; i < animationFrames; i++) {
      if (i > 0) {
        //_display.clear(0, animationWidth, animationHeight, 40, 40);
      }
      
      _display.drawCompressedBitmap(frames, sequenceDictionary, offset, pgm_read_byte_near(framesLength + i), 40, 40, animationWidth, animationHeight);
      //_display.drawBitmapUsingPalette(frames, palette, offset, repeats, pgm_read_byte_near(framesLength + i), animationWidth, animationHeight, 40, 40);
      offset += pgm_read_byte_near(framesLength + i);
      delay(30);
    }
  }
  
  delay(20000);
}